## Kconfig
```kconfig
# Copyright (c) Brandon Pacewic
# SPDX-License-Identifier: MIT

mainmenu "CPL Competitive Programming Library Configuration"

config CPL_VERSION
	string
	default "1.0.0"

menu "Build Targets"
	source "tests/Kconfig"
	source "benchmarks/Kconfig"
	source "tools/Kconfig"
endmenu

menu "Compiler Options"
	config CC_OPTIMIZE_FOR_PERFORMANCE
		bool "Optimize for performance (-O2)"
		default y

	config CC_OPTIMIZE_FOR_SIZE
		bool "Optimize for size (-Os)"

	config DEBUG_INFO
		bool "Include debug information (-g)"
		default y

	config ASAN
		bool "Enable AddressSanitizer"
		depends on !RELEASE

	config UBSAN
		bool "Enable UndefinedBehaviorSanitizer"
		depends on !RELEASE

	config RELEASE
		bool "Release build (strip debug, max optimization)"
endmenu

menu "Library Modules"
	source "cpl/Kconfig"
endmenu
```

## benchmarks/Kconfig
```kconfig
# Copyright (c) Brandon Pacewic
# SPDX-License-Identifier: MIT

# CPL Benchmark Suite Configuration

menuconfig CPL_BENCHMARKS
	bool "CPL Benchmark Suite"
	default y
	help
	  Enable building and running benchmarks for the CPL library.
	  Benchmarks measure performance characteristics of library components
	  using Google Benchmark framework.

if CPL_BENCHMARKS

comment "Container Benchmarks"

config BENCH_CONTAINER_MERGE_SORT
	bool "Container merge sort benchmark"
	default y
	depends on CPL_CONTAINER
	help
	  Benchmark merge sort implementation on containers with various
	  input sizes and data types.

config BENCH_CONTAINER_RUN_LENGTH_ENCODING
	bool "Container run-length encoding benchmark"
	default y
	depends on CPL_CONTAINER
	help
	  Benchmark run-length encoding performance on containers with
	  various input patterns and sizes.

endif # CPL_BENCHMARKS
```

## configs/debug_defconfig
```kconfig
# Copyright (c) Brandon Pacewic
# SPDX-License-Identifier: MIT
#
# Debug configuration for CPL
# Optimized for debugging with sanitizers and debug info

# Compiler Options
# CONFIG_CC_OPTIMIZE_FOR_PERFORMANCE is not set
# CONFIG_CC_OPTIMIZE_FOR_SIZE is not set
CONFIG_DEBUG_INFO=y
CONFIG_ASAN=y
CONFIG_UBSAN=y
# CONFIG_RELEASE is not set

# Library Modules
CONFIG_CPL_LIB=y
CONFIG_CPL_CORE=y
CONFIG_CPL_CONTAINER=y
CONFIG_CPL_MATRIX=y
CONFIG_CPL_MOD=y
CONFIG_CPL_TREE=y

# Test Suite
CONFIG_CPL_TESTS=y
CONFIG_TEST_CONTAINER_ALTERNATING_INSERTION=y
CONFIG_TEST_CONTAINER_DEBUG_OUTPUT=y
CONFIG_TEST_CONTAINER_ENCODING=y
CONFIG_TEST_CONTAINER_IS_CONTAINER_VALIDATION=y
CONFIG_TEST_CONTAINER_MERGE_SORT=y
CONFIG_TEST_CONTAINER_RANGE_MERGE_SORT=y
CONFIG_TEST_CONTAINER_RANGE_REV_SORT=y
CONFIG_TEST_CONTAINER_REV_SORT=y
CONFIG_TEST_DISJOINT_SET=y
CONFIG_TEST_EDGE_COMPARISON=y
CONFIG_TEST_BORUVKA_MST=y
CONFIG_TEST_KRUSKAL_MST=y
CONFIG_TEST_MATRIX_TRACE=y
CONFIG_TEST_Y_COMBINATOR=y

# Benchmark Suite
# CONFIG_CPL_BENCHMARKS is not set

# Tools
CONFIG_CPL_TOOLS=y
CONFIG_TOOL_GRAPH_CASEGEN=y
```

## configs/defconfig
```kconfig
# Copyright (c) Brandon Pacewic
# SPDX-License-Identifier: MIT
#
# Default configuration for CPL
# Balanced configuration with most features enabled

# Compiler Options
CONFIG_CC_OPTIMIZE_FOR_PERFORMANCE=y
# CONFIG_CC_OPTIMIZE_FOR_SIZE is not set
CONFIG_DEBUG_INFO=y
# CONFIG_ASAN is not set
# CONFIG_UBSAN is not set
# CONFIG_RELEASE is not set

# Library Modules
CONFIG_CPL_LIB=y
CONFIG_CPL_CORE=y
CONFIG_CPL_CONTAINER=y
CONFIG_CPL_MATRIX=y
CONFIG_CPL_MOD=y
CONFIG_CPL_TREE=y

# Test Suite
CONFIG_CPL_TESTS=y
CONFIG_TEST_CONTAINER_ALTERNATING_INSERTION=y
CONFIG_TEST_CONTAINER_DEBUG_OUTPUT=y
CONFIG_TEST_CONTAINER_ENCODING=y
CONFIG_TEST_CONTAINER_IS_CONTAINER_VALIDATION=y
CONFIG_TEST_CONTAINER_MERGE_SORT=y
CONFIG_TEST_CONTAINER_RANGE_MERGE_SORT=y
CONFIG_TEST_CONTAINER_RANGE_REV_SORT=y
CONFIG_TEST_CONTAINER_REV_SORT=y
CONFIG_TEST_DISJOINT_SET=y
CONFIG_TEST_EDGE_COMPARISON=y
CONFIG_TEST_BORUVKA_MST=y
CONFIG_TEST_KRUSKAL_MST=y
CONFIG_TEST_MATRIX_TRACE=y
CONFIG_TEST_Y_COMBINATOR=y

# Benchmark Suite
CONFIG_CPL_BENCHMARKS=y
CONFIG_BENCH_CONTAINER_MERGE_SORT=y
CONFIG_BENCH_CONTAINER_RUN_LENGTH_ENCODING=y

# Tools
CONFIG_CPL_TOOLS=y
CONFIG_TOOL_GRAPH_CASEGEN=y
```

## configs/minimal_defconfig
```kconfig
# Copyright (c) Brandon Pacewic
# SPDX-License-Identifier: MIT
#
# Minimal configuration for CPL
# Core library only with basic optimizations

# Compiler Options
CONFIG_CC_OPTIMIZE_FOR_PERFORMANCE=y
# CONFIG_CC_OPTIMIZE_FOR_SIZE is not set
# CONFIG_DEBUG_INFO is not set
# CONFIG_ASAN is not set
# CONFIG_UBSAN is not set
# CONFIG_RELEASE is not set

# Library Modules
CONFIG_CPL_LIB=y
CONFIG_CPL_CORE=y
# CONFIG_CPL_CONTAINER is not set
# CONFIG_CPL_MATRIX is not set
# CONFIG_CPL_MOD is not set
# CONFIG_CPL_TREE is not set

# Test Suite
CONFIG_CPL_TESTS=y
CONFIG_TEST_Y_COMBINATOR=y

# Benchmark Suite
# CONFIG_CPL_BENCHMARKS is not set

# Tools
# CONFIG_CPL_TOOLS is not set
```

## configs/release_defconfig
```kconfig
# Copyright (c) Brandon Pacewic
# SPDX-License-Identifier: MIT
#
# Release configuration for CPL
# Optimized for production use with maximum performance

# Compiler Options
CONFIG_CC_OPTIMIZE_FOR_PERFORMANCE=y
# CONFIG_CC_OPTIMIZE_FOR_SIZE is not set
# CONFIG_DEBUG_INFO is not set
# CONFIG_ASAN is not set
# CONFIG_UBSAN is not set
CONFIG_RELEASE=y

# Library Modules
CONFIG_CPL_LIB=y
CONFIG_CPL_CORE=y
CONFIG_CPL_CONTAINER=y
CONFIG_CPL_MATRIX=y
CONFIG_CPL_MOD=y
CONFIG_CPL_TREE=y

# Test Suite
# CONFIG_CPL_TESTS is not set

# Benchmark Suite
CONFIG_CPL_BENCHMARKS=y
CONFIG_BENCH_CONTAINER_MERGE_SORT=y
CONFIG_BENCH_CONTAINER_RUN_LENGTH_ENCODING=y

# Tools
CONFIG_CPL_TOOLS=y
CONFIG_TOOL_GRAPH_CASEGEN=y
```

## cpl/Kconfig
```kconfig
# Copyright (c) Brandon Pacewic
# SPDX-License-Identifier: MIT

# CPL Library Module Configuration

menuconfig CPL_LIB
	bool "CPL Library Support"
	default y
	help
	  Enable the CPL (Competitive Programming Library) core library.
	  This is a header-only C++ library for competitive programming
	  with data structures and algorithms.

if CPL_LIB

config CPL_CORE
	bool "Core utilities (xcore, xutility)"
	default y
	help
	  Enable core CPL utilities including namespace macros (xcore)
	  and functional programming utilities like y_combinator (xutility).
	  Required by most other CPL modules.

config CPL_CONTAINER
	bool "Container utilities"
	default y
	depends on CPL_CORE
	help
	  Enable container helper utilities including:
	  - ostream overloads for std::pair and standard containers
	  - Container manipulation functions
	  - Debugging output utilities

config CPL_MATRIX
	bool "Matrix library"
	default y
	depends on CPL_CORE
	help
	  Enable matrix data structures and operations including:
	  - basic_uniform_matrix: Fixed-size square matrix
	  - Matrix arithmetic operations
	  - Matrix transformations and algorithms

config CPL_MOD
	bool "Modular arithmetic types"
	default y
	depends on CPL_CORE
	help
	  Enable modular arithmetic types for competitive programming:
	  - mod_type<T>: Generic modular arithmetic wrapper
	  - Automatic modulo operations
	  - Useful for problems requiring MOD arithmetic

config CPL_TREE
	bool "Tree and graph algorithms"
	default y
	depends on CPL_CORE
	help
	  Enable tree and graph data structures including:
	  - Disjoint set (Union-Find) implementation
	  - Graph traversal utilities
	  - Tree algorithms

endif # CPL_LIB
```

## tests/Kconfig
```kconfig
# Copyright (c) Brandon Pacewic
# SPDX-License-Identifier: MIT

# CPL Test Suite Configuration

menuconfig CPL_TESTS
	bool "CPL Test Suite"
	default y
	help
	  Enable building and running tests for the CPL library.
	  Tests verify the correctness of library components.

if CPL_TESTS

comment "Container Tests"

config TEST_CONTAINER_ALTERNATING_INSERTION
	bool "Container alternating insertion test"
	default y
	depends on CPL_CONTAINER
	help
	  Test alternating insertion operations on containers.

config TEST_CONTAINER_DEBUG_OUTPUT
	bool "Container debug output test"
	default y
	depends on CPL_CONTAINER
	help
	  Test ostream overloads for std::pair and standard containers.

config TEST_CONTAINER_ENCODING
	bool "Container encoding test"
	default y
	depends on CPL_CONTAINER
	help
	  Test container encoding and serialization utilities.

config TEST_CONTAINER_IS_CONTAINER_VALIDATION
	bool "Container type validation test"
	default y
	depends on CPL_CONTAINER
	help
	  Test compile-time container type trait validation.

config TEST_CONTAINER_MERGE_SORT
	bool "Container merge sort test"
	default y
	depends on CPL_CONTAINER
	help
	  Test merge sort implementation on containers.

config TEST_CONTAINER_RANGE_MERGE_SORT
	bool "Container range merge sort test"
	default y
	depends on CPL_CONTAINER
	help
	  Test merge sort on container ranges.

config TEST_CONTAINER_RANGE_REV_SORT
	bool "Container range reverse sort test"
	default y
	depends on CPL_CONTAINER
	help
	  Test reverse sorting on container ranges.

config TEST_CONTAINER_REV_SORT
	bool "Container reverse sort test"
	default y
	depends on CPL_CONTAINER
	help
	  Test reverse sorting operations on containers.

comment "Graph and Tree Tests"

config TEST_DISJOINT_SET
	bool "Disjoint set (Union-Find) test"
	default y
	depends on CPL_TREE
	help
	  Test disjoint set data structure implementation.

config TEST_EDGE_COMPARISON
	bool "Edge comparison test"
	default y
	depends on CPL_TREE
	help
	  Test graph edge comparison operations.

config TEST_BORUVKA_MST
	bool "Borůvka MST test"
	default y
	depends on CPL_TREE
	help
	  Test Borůvka's algorithm for minimum spanning tree.

config TEST_KRUSKAL_MST
	bool "Kruskal MST test"
	default y
	depends on CPL_TREE
	help
	  Test Kruskal's algorithm for minimum spanning tree.

comment "Matrix Tests"

config TEST_MATRIX_TRACE
	bool "Matrix trace test"
	default y
	depends on CPL_MATRIX
	help
	  Test matrix trace computation (sum of diagonal elements).

comment "Core Utility Tests"

config TEST_Y_COMBINATOR
	bool "Y combinator test"
	default y
	depends on CPL_CORE
	help
	  Test y_combinator utility for lambda recursion.

endif # CPL_TESTS
```

## tools/Kconfig
```kconfig
# Copyright (c) Brandon Pacewic
# SPDX-License-Identifier: MIT

# CPL Tools Configuration

menuconfig CPL_TOOLS
	bool "CPL Utility Tools"
	default y
	help
	  Enable building utility tools for the CPL library.
	  Tools provide auxiliary functionality like test case generation
	  and analysis scripts.

if CPL_TOOLS

comment "Case Generation Tools"

config TOOL_GRAPH_CASEGEN
	bool "Graph case generator"
	default y
	depends on CPL_TREE
	help
	  Build the graph test case generator tool for creating graph-based
	  competitive programming test inputs. Useful for testing graph
	  algorithms and generating edge cases.

endif # CPL_TOOLS
```
